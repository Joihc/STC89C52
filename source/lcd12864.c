#define LCD12864_C_
#include "lcd12864.h"

unsigned char code zhu[]= { /* 0X00,0X01,0X80,0X00,0X40,0X00, */
0XFF,0XFF,0XFF,0XFF,0XFF,0XFF,0XFF,0XFF,0XFF,0XFF,0XFF,0XFF,0XFF,0XFF,0XFF,0XFF,
0XFF,0XFF,0XFF,0XFF,0XFF,0XFF,0XFF,0XFF,0XFF,0XFF,0XFF,0XFF,0XFF,0XFF,0XFF,0XFF,
0XC0,0X00,0X00,0X00,0X00,0X00,0X00,0X00,0X00,0X00,0X00,0X00,0X00,0X00,0X00,0X03,
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0XFF,0XFF,0XFF,0XFF,0XFF,0XFF,0XFF,0XFF,0XFF,0XFF,0XFF,0XFF,0XFF,0XFF,0XFF,0XFF,
};
uint8 code string_1[16]    = {"云厨热能有限公司"};
uint8 code string_2[16]    = {"电话:15680850437"};



#define m 11
#define n 9




uint8 main_page = 0;//当前在那个页面

const uint8 menu_step;

void Display_Start()
{
	uint8 i;
	Display_Pic();
	for(i=0;i<10;i++)
	delayms(4000);
	
	Wr_Command(0x01,1); //显示清屏
	
	Display_String(2,string_1);
	Display_String(3,string_2);
	for(i=0;i<10;i++)
	delayms(4000);
}



void Display_String(uint8 line,uint8 *string)//显示字符串
{
	uint8 addr,i;
	Wr_Command(0x30,1);        //回到基本指令集
	if(line==1)
	addr=0x80;
	else if(line==2)
	addr=0x90;
	else if(line==3)
	addr=0x88;
	else if(line==4)
	addr=0x98;
	Wr_Command(addr,1);
	for(i=0;i<16;i++)
	{
		Wr_Data(*string++);
	}
}
void Display_Pic()
{
		uint8 i,j,k;
		uint8 *ptr = zhu;
		
		Wr_Command(0x34,1); //打开扩展指令集
		i = 0x80;            
		for(j = 0;j < 32;j++)
		{
        Wr_Command(i++,1);
        Wr_Command(0x80,1);
				for(k = 0;k < 16;k++)
				{
					Wr_Data(*ptr++);
				}
		}
		i = 0x80;
		for(j = 0;j < 32;j++)
		{
				Wr_Command(i++,1);
        Wr_Command(0x88,1);   
				for(k = 0;k < 16;k++)
				{
					Wr_Data(*ptr++);
				} 
		}  
    Wr_Command(0x36,1);        //打开绘图显示
		Wr_Command(0x30,1);        //回到基本指令集
}
void Wr_Data(uint8 wrdata) //写数据
{
	RDbf();
	RS=1;
	RW=0;
	E=1;
	//LCMdata=wrdata;
	Set_LCMdata(wrdata);
	E=0;
}

void Wr_Command(uint8 wrcommand,busyc) //写指令
{
	if(busyc)
	RDbf();
	RS=0;
	RW=0;
	E=1;
	//LCMdata=wrcommand;
	Set_LCMdata(wrcommand);
	E=0;
}

void RDbf(void) //读忙状态
{
	while(1)
	{
		RS=0;
		RW=1;
		E=0;
		LCMdata=0xFF;
		E=1;
		if((LCMdata&Busy)==0)
		break;
	}
}

void Lcm_Init(void)
{
	PSB =1;
	REST=1;
	REST=0;
	delayms(20);
	REST=1;
	Wr_Command(0x30,0);
	delayms(5);
	Wr_Command(0x30,0); //2次显示模式设置，不用判忙
	delayms(5);
	Wr_Command(0x0C,1); //开显示及光标设置
	delayms(5);
	Wr_Command(0x01,1); //显示清屏
	delayms(5);
	delayms(5);
	Wr_Command(0x06,1); //显示光标移动设置
	delayms(5);
}

void Set_LCMdata(uint8 wrdata)
{
	Test_Bit(wrdata,0)?Set_Bit(LCMdata,7):Clr_Bit(LCMdata,7);
	Test_Bit(wrdata,1)?Set_Bit(LCMdata,6):Clr_Bit(LCMdata,6);
	Test_Bit(wrdata,2)?Set_Bit(LCMdata,5):Clr_Bit(LCMdata,5);
	Test_Bit(wrdata,3)?Set_Bit(LCMdata,4):Clr_Bit(LCMdata,4);
	Test_Bit(wrdata,4)?Set_Bit(LCMdata,3):Clr_Bit(LCMdata,3);
	Test_Bit(wrdata,5)?Set_Bit(LCMdata,2):Clr_Bit(LCMdata,2);
	Test_Bit(wrdata,6)?Set_Bit(LCMdata,1):Clr_Bit(LCMdata,1);
	Test_Bit(wrdata,7)?Set_Bit(LCMdata,0):Clr_Bit(LCMdata,0);
}

void Display_Menu()
{}
